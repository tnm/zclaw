## main/Kconfig.projbuild
```kconfig
menu "zclaw Configuration"

    config ZCLAW_WIFI_SSID
        string "WiFi SSID (for testing only)"
        default ""
        help
            WiFi network name fallback. Leave empty to use NVS provisioning.
            Recommended: run ./scripts/provision.sh after flashing.

    config ZCLAW_WIFI_PASSWORD
        string "WiFi Password (for testing only)"
        default ""
        help
            WiFi network password fallback. Leave empty to use NVS provisioning.

    config ZCLAW_CLAUDE_API_KEY
        string "LLM API Key (for testing only)"
        default ""
        help
            Anthropic API key fallback. Leave empty to use NVS provisioning.

    config ZCLAW_ALLOW_UNENCRYPTED_NVS_FALLBACK
        bool "Allow unencrypted NVS fallback when flash encryption is enabled (dev only)"
        default n
        help
            If disabled (recommended), firmware startup fails when encrypted NVS
            initialization fails under active flash encryption.
            Enable only for explicit local debug scenarios.

    config ZCLAW_STUB_LLM
        bool "Stub LLM responses (for QEMU testing)"
        default n
        help
            When enabled, returns hardcoded responses instead of calling the LLM API.
            Useful for testing without WiFi (QEMU emulator).

    config ZCLAW_STUB_TELEGRAM
        bool "Stub Telegram (for QEMU testing)"
        default n
        help
            When enabled, skips Telegram initialization.
            Useful for testing without WiFi.

    config ZCLAW_CHANNEL_UART
        bool "Use UART0 for local channel (QEMU-friendly)"
        default n
        help
            Uses UART0 instead of USB Serial/JTAG for local input/output.
            Enable this for interactive QEMU use.

    config ZCLAW_EMULATOR_MODE
        bool "Offline emulator mode (skip WiFi/NTP/Telegram startup)"
        default n
        help
            Starts only local channel + agent loop, without WiFi-dependent startup.
            Intended for QEMU development workflows.

    config ZCLAW_EMULATOR_LIVE_LLM
        bool "Host-bridged live LLM in emulator mode"
        default n
        help
            Routes LLM requests over UART to a host-side bridge process so QEMU can
            use real provider APIs without guest WiFi/TLS networking.
            Intended for emulator testing only.

    menu "Voice (Experimental)"
        config ZCLAW_VOICE
            bool "Enable on-device voice pipeline (VAD + cloud STT)"
            default n
            help
                Enables experimental voice input pipeline intended for ESP32-S3-class
                targets with digital microphone front-ends (STD-I2S or PDM).
                Keep disabled for default low-footprint builds.

        if ZCLAW_VOICE
            config ZCLAW_VOICE_SAMPLE_RATE_HZ
                int "Voice capture sample rate (Hz)"
                range 8000 48000
                default 16000
                help
                    PCM capture sample rate used by voice input.

            config ZCLAW_VOICE_FRAME_MS
                int "Voice frame size (ms)"
                range 10 100
                default 30
                help
                    Frame size used by voice capture/processing pipeline.

            config ZCLAW_VOICE_RELAY_STT
                bool "Enable host-relay STT bridge"
                default y
                help
                    Streams captured PCM audio to scripts/web_relay.py for
                    cloud transcription on the host side. Keep enabled for
                    low-footprint firmware experiments.

            choice ZCLAW_VOICE_RELAY_TRANSPORT
                prompt "Relay STT transport"
                default ZCLAW_VOICE_RELAY_TRANSPORT_SERIAL
                depends on ZCLAW_VOICE_RELAY_STT
                help
                    Transport used to send captured voice audio to the host relay.

                config ZCLAW_VOICE_RELAY_TRANSPORT_SERIAL
                    bool "Serial sideband (legacy)"
                    help
                        Sends base64 PCM chunks over the channel sideband protocol.

                config ZCLAW_VOICE_RELAY_TRANSPORT_HTTP
                    bool "HTTP upload"
                    help
                        Sends PCM audio to a host HTTP relay endpoint.
            endchoice

            config ZCLAW_VOICE_HTTP_STT_URL
                string "HTTP relay STT endpoint URL"
                default ""
                depends on ZCLAW_VOICE_RELAY_TRANSPORT_HTTP
                help
                    Full URL of the host relay endpoint, for example:
                    http://192.168.1.10:8787/api/voice/stt

            config ZCLAW_VOICE_HTTP_API_KEY
                string "HTTP relay API key (optional)"
                default ""
                depends on ZCLAW_VOICE_RELAY_TRANSPORT_HTTP
                help
                    Optional API key sent as X-Zclaw-Key for relay auth.

            choice ZCLAW_VOICE_CAPTURE_MODE
                prompt "Voice capture front-end"
                default ZCLAW_VOICE_CAPTURE_STD_I2S
                help
                    Select the digital microphone signaling mode.

                config ZCLAW_VOICE_CAPTURE_STD_I2S
                    bool "STD-I2S microphone (BCLK/WS/DIN)"
                    help
                        Use standard I2S serial microphone wiring.

                config ZCLAW_VOICE_CAPTURE_PDM
                    bool "PDM microphone (CLK/DIN)"
                    help
                        Use pulse-density modulation microphone wiring.
            endchoice

            config ZCLAW_VOICE_VAD_START_THRESHOLD
                int "VAD start threshold (mean abs PCM)"
                range 100 20000
                default 1200
                help
                    Mean absolute PCM amplitude required to start a voice turn.

            config ZCLAW_VOICE_VAD_END_THRESHOLD
                int "VAD end threshold (mean abs PCM)"
                range 100 20000
                default 700
                help
                    Mean absolute PCM amplitude treated as silence while
                    capturing an utterance.

            config ZCLAW_VOICE_MIN_UTTERANCE_MS
                int "Minimum utterance duration (ms)"
                range 200 5000
                default 600
                help
                    Minimum captured speech duration before transcription.

            config ZCLAW_VOICE_MAX_UTTERANCE_MS
                int "Maximum utterance duration (ms)"
                range 1000 20000
                default 6000
                help
                    Hard cap on one captured utterance duration.

            config ZCLAW_VOICE_SILENCE_END_MS
                int "Silence hold to end utterance (ms)"
                range 200 5000
                default 900
                help
                    Consecutive silence duration that finalizes an utterance.

            config ZCLAW_VOICE_RELAY_TIMEOUT_MS
                int "Relay STT response timeout (ms)"
                range 5000 120000
                default 45000
                help
                    Maximum wait for host relay transcription response.

            config ZCLAW_VOICE_CAPTURE_ALLOC_RESERVE_BYTES
                int "Heap reserve for voice capture allocation (bytes)"
                range 2048 131072
                default 32768
                help
                    Minimum internal-heap headroom preserved when sizing the
                    voice utterance capture buffer. Lower values increase max
                    utterance duration on low-memory boards but can raise risk
                    of runtime heap pressure.

            config ZCLAW_VOICE_I2S_PORT
                int "I2S controller index"
                range 0 1
                default 0
                help
                    I2S peripheral index used for microphone capture.

            config ZCLAW_VOICE_I2S_BCLK_GPIO
                int "STD-I2S BCLK GPIO"
                range -1 48
                default -1
                help
                    Bit clock pin for STD-I2S microphone.
                    Set to -1 to keep voice capture disabled at runtime.

            config ZCLAW_VOICE_I2S_WS_GPIO
                int "STD-I2S WS/LRCLK GPIO"
                range -1 48
                default -1
                help
                    Word-select / LRCLK pin for STD-I2S microphone.
                    Set to -1 to keep voice capture disabled at runtime.

            config ZCLAW_VOICE_I2S_DIN_GPIO
                int "STD-I2S DIN GPIO"
                range -1 48
                default -1
                help
                    Data-in pin for STD-I2S microphone.
                    Set to -1 to keep voice capture disabled at runtime.

            config ZCLAW_VOICE_PDM_CLK_GPIO
                int "PDM CLK GPIO"
                range -1 48
                default -1
                help
                    Clock pin for PDM microphone.
                    Set to -1 to keep voice capture disabled at runtime.

            config ZCLAW_VOICE_PDM_DIN_GPIO
                int "PDM DIN GPIO"
                range -1 48
                default -1
                help
                    Data-in pin for PDM microphone.
                    Set to -1 to keep voice capture disabled at runtime.
        endif
    endmenu

    menu "GPIO Tool Safety"
        config ZCLAW_GPIO_MIN_PIN
            int "Minimum GPIO pin exposed to tools"
            range 0 48
            default 2
            help
                Lower bound for gpio_write/gpio_read tool access.
                Set this to match safe, wired pins on your board.

        config ZCLAW_GPIO_MAX_PIN
            int "Maximum GPIO pin exposed to tools"
            range 0 48
            default 10
            help
                Upper bound for gpio_write/gpio_read tool access.
                Set this to match safe, wired pins on your board.

        config ZCLAW_GPIO_ALLOWED_PINS
            string "Allowed GPIO pins list (optional)"
            default ""
            help
                Optional comma-separated allowlist for gpio_write/gpio_read.
                Example: "1,2,3,4,5,6,7,8,9,43,44"
                When set (non-empty), this list is used instead of min/max range.
    endmenu

    menu "Factory Reset"
        config ZCLAW_FACTORY_RESET_PIN
            int "Factory reset button GPIO"
            range 0 48
            default 9
            help
                Hold this pin low during startup for the configured hold time
                to erase NVS settings and restart.
                Set this to your board's wired reset/config button GPIO.

        config ZCLAW_FACTORY_RESET_HOLD_MS
            int "Factory reset hold time (ms)"
            range 1000 60000
            default 5000
            help
                Duration the reset pin must stay low to trigger factory reset.
    endmenu

endmenu
```

## sdkconfig.defaults
```kconfig
# Target
CONFIG_IDF_TARGET="esp32c3"

# Partition table
CONFIG_PARTITION_TABLE_CUSTOM=y
CONFIG_PARTITION_TABLE_CUSTOM_FILENAME="partitions.csv"
CONFIG_ESPTOOLPY_FLASHSIZE_4MB=y
CONFIG_ESPTOOLPY_FLASHSIZE="4MB"

# Size optimization
CONFIG_COMPILER_OPTIMIZATION_SIZE=y
CONFIG_NEWLIB_NANO_FORMAT=y

# FreeRTOS
CONFIG_FREERTOS_HZ=1000

# mbedTLS - needed for HTTPS (reduced cert bundle)
CONFIG_MBEDTLS_SSL_MAX_CONTENT_LEN=16384
CONFIG_MBEDTLS_CERTIFICATE_BUNDLE=y
CONFIG_MBEDTLS_CERTIFICATE_BUNDLE_DEFAULT_CMN=y

# HTTP client
CONFIG_ESP_HTTP_CLIENT_ENABLE_HTTPS=y

# Logging (reduced for size)
CONFIG_LOG_DEFAULT_LEVEL_INFO=y
CONFIG_LOG_MAXIMUM_LEVEL_INFO=y

# Stack sizes
CONFIG_ESP_MAIN_TASK_STACK_SIZE=8192
CONFIG_ESP_SYSTEM_EVENT_TASK_STACK_SIZE=4096

# WiFi
CONFIG_ESP_WIFI_STATIC_RX_BUFFER_NUM=4
CONFIG_ESP_WIFI_DYNAMIC_RX_BUFFER_NUM=8
CONFIG_ESP_WIFI_TX_BUFFER_TYPE=0
CONFIG_ESP_WIFI_STATIC_TX_BUFFER_NUM=4
# Keep STA/WPA2 path lean on default build target to stay within firmware budget.
# CONFIG_ESP_WIFI_ENABLE_WPA3_SAE is not set
# CONFIG_ESP_WIFI_ENABLE_SAE_PK is not set
# CONFIG_ESP_WIFI_SOFTAP_SAE_SUPPORT is not set
# CONFIG_ESP_WIFI_ENABLE_WPA3_OWE_STA is not set
# CONFIG_ESP_WIFI_ENTERPRISE_SUPPORT is not set

# TCP/IP stack (unused optional features disabled for size)
# CONFIG_LWIP_IPV6 is not set
# CONFIG_LWIP_DNS_SUPPORT_MDNS_QUERIES is not set

# Watchdog - longer timeout for API calls
CONFIG_ESP_TASK_WDT_TIMEOUT_S=60

# OTA updates
CONFIG_BOOTLOADER_APP_ROLLBACK_ENABLE=y

# GPIO tool safety defaults
CONFIG_ZCLAW_GPIO_MIN_PIN=2
CONFIG_ZCLAW_GPIO_MAX_PIN=10
```
